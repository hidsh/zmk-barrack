## boards/shields/barrack/Kconfig.defconfig
```kconfig
if SHIELD_BARRACK

    config ZMK_KEYBOARD_NAME
        default "BARRACK"

    config ZMK_BLE
        bool
        default y

endif
```

## boards/shields/barrack/Kconfig.shield
```kconfig
# No whitespace after the comma or in your keyboard name!
config SHIELD_BARRACK
    def_bool $(shields_list_contains,barrack)
```

## config/west.yml
```yaml
manifest:
  projects:
    - name: zmk
      remote: zmkfirmware
      revision: main
      import: app/west.yml
    - name: zmk-barrack
      remote: hidsh
      revision: main
  self:
    path: config
```
